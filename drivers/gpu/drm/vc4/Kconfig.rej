## drivers/gpu/drm/vc4/Kconfig.rej
```kconfig
--- drivers/gpu/drm/vc4/Kconfig
+++ drivers/gpu/drm/vc4/Kconfig
@@ -1,6 +1,6 @@
 config DRM_VC4
 	tristate "Broadcom VC4 Graphics"
-	depends on ARCH_BCM2835 || COMPILE_TEST
+	depends on ARCH_BCM2835 || ARCH_BCM2708 || ARCH_BCM2709 || COMPILE_TEST
 	depends on DRM && HAVE_DMA_ATTRS
 	select DRM_KMS_HELPER
 	select DRM_KMS_CMA_HELPER
```
